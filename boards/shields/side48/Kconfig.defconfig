## boards/shields/side48/Kconfig.defconfig
```kconfig
if SHIELD_SIDE48_R

config ZMK_KEYBOARD_NAME
    default "SIDE48"

config ZMK_BLE
    default y

config ZMK_SPLIT_ROLE_CENTRAL
    default y

config INPUT
    default y

config ZMK_POINTING
    default y

config SPI
    default y

endif


if SHIELD_SIDE48_R || SHIELD_SIDE48_L

config ZMK_SPLIT
    default y

config ZMK_KSCAN_CHARLIEPLEX_WAIT_BEFORE_INPUTS
    default 20

config RGBLED_WIDGET_BATTERY_LEVEL_HIGH
    default 30

config RGBLED_WIDGET_BATTERY_LEVEL_CRITICAL
    default 10

endif
```

## boards/shields/side48/Kconfig.shield
```kconfig
config SHIELD_SIDE48_R
    def_bool $(shields_list_contains,side48_r)

config SHIELD_SIDE48_L
    def_bool $(shields_list_contains,side48_l)
```

## config/west.yml
```yaml
manifest:
  remotes:
    - name: cormoran    # DYA Studio 対応 ZMK fork / モジュール
      url-base: https://github.com/cormoran
    - name: zmkfirmware
      url-base: https://github.com/zmkfirmware
    - name: powerenterkey
      url-base: https://github.com/PowerEnterKey
    - name: caksoylar  # RGB LED
      url-base: https://github.com/caksoylar
    - name: badjeff    # PMW3610
      url-base: https://github.com/badjeff
  projects:
    # DYA Studio 用に、カスタム Studio RPC を含む cormoran の ZMK v0.3 fork を使う
    - name: zmk
      remote: cormoran
      revision: v0.3-branch+dya
      import: app/west.yml
    # --- DYA Studio 拡張モジュール ---
    - name: zmk-module-ble-management        # 接続(BLEプロファイル)管理
      remote: cormoran
      revision: zmk-v0.3.0.0
    - name: zmk-module-settings-rpc          # デバイス設定
      remote: cormoran
      revision: zmk-v0.3.0.0
    - name: zmk-module-runtime-input-processor  # トラックボール設定をランタイムで変更
      remote: cormoran
      revision: zmk-v0.3.0.0
    - name: zmk-behavior-runtime-sensor-rotate
      remote: cormoran
      revision: zmk-v0.3.0.0
    - name: zmk-feature-runtime-macro
      remote: cormoran
      revision: <TAG>
      import: true
    - name: zmk-feature-runtime-combo
      remote: cormoran
      revision: <TAG>
      import: true
    # --- 既存 ---
    - name: zmk-rgbled-widget
      remote: caksoylar
      revision: v0.3-branch
    - name: zmk-pmw3610-driver
      remote: badjeff
      revision: main
  self:
    path: config
```
